## ztp/Config.in
```kconfig
# ZTP configuration
menu "Configuration"
    depends on PACKAGE_ztp
    config ZTP_URL
        string "ZTP Server URL"
        default "0.0.0.0"
    config ZTP_SECRET
        string "ZTP Server Secret"
        default "jBqenDkRHd4ztdTeVeG2hYkM"
endmenu
```
